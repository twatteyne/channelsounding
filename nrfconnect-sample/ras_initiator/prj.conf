## Kconfig
```
#
# Copyright (c) 2026 Nordic Semiconductor ASA
#
# SPDX-License-Identifier: LicenseRef-Nordic-5-Clause
#

menu "Channel Sounding RAS Initiator sample"

choice SAMPLE_RAS_INITIATOR_STEP_MODE
	prompt "Channel Sounding Step Modes selection"
	default SAMPLE_RAS_INITIATOR_STEP_MODE_2_SUB_MODE_1

config SAMPLE_RAS_INITIATOR_STEP_MODE_2_SUB_MODE_1
	bool "Main: 2, Sub: 1."
	help
	  This option enables CS with main mode 2 and submode 1.
	  Mode 2 steps are used for PBR and mode 1 steps are used for RTT.

config SAMPLE_RAS_INITIATOR_STEP_MODE_1
	bool "Main: 1, Sub: unused."
	help
	  This option enables CS with main mode 1 and submode unused.
	  Mode 1 steps are used for RTT.

config SAMPLE_RAS_INITIATOR_STEP_MODE_2
	bool "Main: 2, Sub: unused."
	help
	  This option enables CS with main mode 2 and submode unused.
	  Mode 2 steps are used for PBR.

config SAMPLE_RAS_INITIATOR_STEP_MODE_3
	bool "Main: 3, Sub: unused."
	select BT_RAS_MODE_3_SUPPORTED
	select BT_CTLR_SDC_CS_STEP_MODE3
	help
	  This option enables CS with main mode 3 and submode unused.
	  Mode 3 steps are used for PBR and RTT.

endchoice

menu "Channel map selection"

config SAMPLE_RAS_INITIATOR_CH_MIN
	int "Lowest CS channel used"
	range 2 76
	default 2
	help
	  Lowest CS channel index (frequency = 2402 + channel MHz) kept in the
	  channel map. Together with CH_MAX it sets the frequency span.

config SAMPLE_RAS_INITIATOR_CH_MAX
	int "Highest CS channel used"
	range 2 76
	default 76
	help
	  Highest CS channel index kept in the channel map.

config SAMPLE_RAS_INITIATOR_CH_STEP
	int "Keep one channel every N"
	range 1 36
	default 1
	help
	  Keep channels CH_MIN, CH_MIN + N, CH_MIN + 2N, ... up to CH_MAX.
	  Channels forbidden by the spec (23-25) are always excluded.
	  The resulting map must contain at least 15 channels.

endmenu

endmenu

source "Kconfig.zephyr"
```

## prj.conf
```kconfig
#
# Copyright (c) 2024 Nordic Semiconductor ASA
#
# SPDX-License-Identifier: LicenseRef-Nordic-5-Clause
#

CONFIG_NCS_SAMPLES_DEFAULTS=y
CONFIG_DK_LIBRARY=y

CONFIG_BT=y
CONFIG_BT_SMP=y
CONFIG_BT_CENTRAL=y
CONFIG_BT_MAX_CONN=1
CONFIG_BT_BONDABLE=n

CONFIG_BT_GATT_CLIENT=y
CONFIG_BT_GATT_DYNAMIC_DB=y

CONFIG_BT_CHANNEL_SOUNDING=y
CONFIG_BT_RAS=y
CONFIG_BT_RAS_RREQ=y

CONFIG_BT_SCAN=y
CONFIG_BT_SCAN_FILTER_ENABLE=y
CONFIG_BT_SCAN_UUID_CNT=1

# The Ranging Profile recommends a MTU of at least 247 octets.
CONFIG_BT_L2CAP_TX_MTU=498
CONFIG_BT_BUF_ACL_TX_SIZE=502
CONFIG_BT_BUF_ACL_RX_SIZE=502
CONFIG_BT_ATT_PREPARE_COUNT=3
CONFIG_BT_CTLR_DATA_LENGTH_MAX=251

# This reduces RAM usage. Additional RAM is needed to support optional
# features such as mode 3 or multiantenna. Change or remove these if
# using those features
CONFIG_BT_RAS_MODE_3_SUPPORTED=n
CONFIG_BT_RAS_MAX_ANTENNA_PATHS=1
CONFIG_BT_CS_DE_MAX_NUM_ANTENNA_PATHS=1
CONFIG_BT_CTLR_SDC_CS_MAX_ANTENNA_PATHS=1
CONFIG_BT_CTLR_SDC_CS_NUM_ANTENNAS=1
CONFIG_BT_CTLR_SDC_CS_STEP_MODE3=n
CONFIG_BT_CTLR_SDC_CS_ROLE_INITIATOR_ONLY=y

# Disabling the CS Test command reduces flash usage
CONFIG_BT_CTLR_CHANNEL_SOUNDING_TEST=n

# This allows CS and ACL to use different PHYs
CONFIG_BT_TRANSMIT_POWER_CONTROL=y

# This improves the performance of floating-point operations
CONFIG_FPU=y
CONFIG_FPU_SHARING=y

CONFIG_CBPRINTF_FP_SUPPORT=y

CONFIG_BT_CS_DE=y
CONFIG_BT_CS_DE_512_NFFT=y

# Channel map selection (frequency span = CH_MAX - CH_MIN MHz)
CONFIG_SAMPLE_RAS_INITIATOR_CH_MIN=2
CONFIG_SAMPLE_RAS_INITIATOR_CH_MAX=76
CONFIG_SAMPLE_RAS_INITIATOR_CH_STEP=1
```

## src/main.c
```c
/*
 * Copyright (c) 2024 Nordic Semiconductor ASA
 *
 * SPDX-License-Identifier: LicenseRef-Nordic-5-Clause
 */

/** @file
 *  @brief Channel Sounding Initiator with Ranging Requestor sample
 *
 *  Source layout:
 *   - main.c              : top-level sequence (connect, set up CS, print distances)
 *   - connection.c        : scanning, connection, security, MTU, GATT discovery
 *   - cs_setup.c          : CS default settings, config, security, procedure enable
 *   - ranging.c           : RAS RREQ, collection of local and peer step data
 *   - cs_processing.c     : tone / RTT / RSSI extraction and cs_de estimation
 *   - distance_estimate.c : sliding-window median of the distance estimates
 *   - csv_export.c        : CSV output of each procedure (see scripts/)
 */

#include <zephyr/kernel.h>
#include <zephyr/bluetooth/bluetooth.h>
#include <dk_buttons_and_leds.h>

#include <zephyr/logging/log.h>
LOG_MODULE_REGISTER(app_main, LOG_LEVEL_INF);

#include "app_config.h"
#include "connection.h"
#include "cs_setup.h"
#include "distance_estimate.h"
#include "ranging.h"

int main(void)
{
	int err;
	bool realtime_rd;
	struct bt_conn *conn;

	LOG_INF("Starting Channel Sounding Initiator Sample");

	dk_leds_init();

	err = bt_enable(NULL);
	if (err) {
		LOG_ERR("Bluetooth init failed (err %d)", err);
		return 0;
	}

	/* Connect to a Ranging Service peer. */
	if (connection_scan_start()) {
		return 0;
	}

	conn = connection_wait_connected();

	if (connection_secure(conn)) {
		return 0;
	}

	connection_exchange_mtu(conn);

	if (connection_discover_ras(conn)) {
		return 0;
	}

	/* Set up ranging data transfer and Channel Sounding. */
	if (cs_setup_default_settings(conn) ||
	    ranging_subscribe(conn, &realtime_rd) ||
	    cs_setup_read_remote_capabilities(conn) ||
	    cs_setup_create_config(conn) ||
	    cs_setup_enable_security(conn) ||
	    cs_setup_start_procedures(conn, realtime_rd)) {
		return 0;
	}

	/* Print the filtered distance each time a new estimate is available. */
	while (true) {
		distance_estimate_wait();
		for (uint8_t ap = 0; ap < MAX_AP; ap++) {
			if (distance_estimate_available(ap)) {
				distance_estimate_print(ap);
			}
		}
	}

	return 0;
}
```

## src/app_config.h
```c
/*
 * Copyright (c) 2024 Nordic Semiconductor ASA
 *
 * SPDX-License-Identifier: LicenseRef-Nordic-5-Clause
 */

/** @file
 *  @brief Compile-time configuration shared by the initiator modules.
 */

#ifndef APP_CONFIG_H_
#define APP_CONFIG_H_

#include <zephyr/bluetooth/conn.h>

#define CS_CONFIG_ID 0

#if defined(CONFIG_SAMPLE_RAS_INITIATOR_STEP_MODE_2_SUB_MODE_1)
#define CS_CONFIG_MODE BT_CONN_LE_CS_MAIN_MODE_2_SUB_MODE_1
#elif defined(CONFIG_SAMPLE_RAS_INITIATOR_STEP_MODE_2)
#define CS_CONFIG_MODE BT_CONN_LE_CS_MAIN_MODE_2_NO_SUB_MODE
#elif defined(CONFIG_SAMPLE_RAS_INITIATOR_STEP_MODE_1)
#define CS_CONFIG_MODE BT_CONN_LE_CS_MAIN_MODE_1_NO_SUB_MODE
#elif defined(CONFIG_SAMPLE_RAS_INITIATOR_STEP_MODE_3)
#define CS_CONFIG_MODE BT_CONN_LE_CS_MAIN_MODE_3_NO_SUB_MODE
#else
BUILD_ASSERT(false, "Invalid ranging mode");
#endif

#define NUM_MODE_0_STEPS 3

/* Maximum number of antenna paths. */
#define MAX_AP (CONFIG_BT_RAS_MAX_ANTENNA_PATHS)

/* CS channel 2 is the first usable channel (index 0 in cs_de arrays). */
#define CHANNEL_INDEX_OFFSET (2)

/* ACL connection interval, in 1.25 ms units. */
#define CONN_INTERVAL 0x10

#endif /* APP_CONFIG_H_ */
```

## src/connection.c
```c
/*
 * Copyright (c) 2024 Nordic Semiconductor ASA
 *
 * SPDX-License-Identifier: LicenseRef-Nordic-5-Clause
 */

#include <zephyr/kernel.h>
#include <zephyr/sys/reboot.h>
#include <zephyr/bluetooth/conn.h>
#include <zephyr/bluetooth/gatt.h>
#include <bluetooth/scan.h>
#include <bluetooth/gatt_dm.h>
#include <bluetooth/services/ras.h>
#include <dk_buttons_and_leds.h>

#include <zephyr/logging/log.h>
LOG_MODULE_DECLARE(app_main, LOG_LEVEL_INF);

#include "app_config.h"
#include "connection.h"

#define CON_STATUS_LED DK_LED1

static K_SEM_DEFINE(sem_connected, 0, 1);
static K_SEM_DEFINE(sem_security, 0, 1);
static K_SEM_DEFINE(sem_mtu_exchange_done, 0, 1);
static K_SEM_DEFINE(sem_discovery_done, 0, 1);

static struct bt_conn *connection;

static struct bt_le_conn_param conn_param =
	BT_LE_CONN_PARAM_INIT(CONN_INTERVAL, CONN_INTERVAL, 0, BT_GAP_MS_TO_CONN_TIMEOUT(4000));

/* ---------------------------------------------------------------------------
 * Connection callbacks
 * ------------------------------------------------------------------------- */

static void connected_cb(struct bt_conn *conn, uint8_t err)
{
	char addr[BT_ADDR_LE_STR_LEN];

	(void)bt_addr_le_to_str(bt_conn_get_dst(conn), addr, sizeof(addr));
	LOG_INF("Connected to %s (err 0x%02X)", addr, err);

	if (err) {
		bt_conn_unref(conn);
		connection = NULL;
	} else {
		connection = bt_conn_ref(conn);

		k_sem_give(&sem_connected);

		dk_set_led_on(CON_STATUS_LED);
	}
}

static void disconnected_cb(struct bt_conn *conn, uint8_t reason)
{
	LOG_INF("Disconnected (reason 0x%02X)", reason);

	bt_conn_unref(conn);
	connection = NULL;
	dk_set_led_off(CON_STATUS_LED);

	sys_reboot(SYS_REBOOT_COLD);
}

static bool le_param_req(struct bt_conn *conn, struct bt_le_conn_param *param)
{
	/* Ignore peer parameter preferences. */
	return false;
}

static void security_changed(struct bt_conn *conn, bt_security_t level, enum bt_security_err err)
{
	char addr[BT_ADDR_LE_STR_LEN];

	bt_addr_le_to_str(bt_conn_get_dst(conn), addr, sizeof(addr));

	if (err) {
		LOG_ERR("Security failed: %s level %u err %d %s", addr, level, err,
			bt_security_err_to_str(err));
		return;
	}

	LOG_INF("Security changed: %s level %u", addr, level);
	k_sem_give(&sem_security);
}

BT_CONN_CB_DEFINE(conn_cb) = {
	.connected = connected_cb,
	.disconnected = disconnected_cb,
	.le_param_req = le_param_req,
	.security_changed = security_changed,
};

/* ---------------------------------------------------------------------------
 * Scanning
 * ------------------------------------------------------------------------- */

static void scan_filter_match(struct bt_scan_device_info *device_info,
			      struct bt_scan_filter_match *filter_match, bool connectable)
{
	char addr[BT_ADDR_LE_STR_LEN];

	bt_addr_le_to_str(device_info->recv_info->addr, addr, sizeof(addr));

	LOG_INF("Filters matched. Address: %s connectable: %d", addr, connectable);
}

static void scan_connecting_error(struct bt_scan_device_info *device_info)
{
	int err;

	LOG_INF("Connecting failed, restarting scanning");

	err = bt_scan_start(BT_SCAN_TYPE_SCAN_PASSIVE);
	if (err) {
		LOG_ERR("Failed to restart scanning (err %i)", err);
		return;
	}
}

static void scan_connecting(struct bt_scan_device_info *device_info, struct bt_conn *conn)
{
	LOG_INF("Connecting");
}

BT_SCAN_CB_INIT(scan_cb, scan_filter_match, NULL, scan_connecting_error, scan_connecting);

static int scan_init(struct bt_scan_init_param *p_param)
{
	int err;

	bt_scan_init(p_param);
	bt_scan_cb_register(&scan_cb);

	err = bt_scan_filter_add(BT_SCAN_FILTER_TYPE_UUID, BT_UUID_RANGING_SERVICE);
	if (err) {
		LOG_ERR("Scanning filters cannot be set (err %d)", err);
		return err;
	}

	err = bt_scan_filter_enable(BT_SCAN_UUID_FILTER, false);
	if (err) {
		LOG_ERR("Filters cannot be turned on (err %d)", err);
		return err;
	}

	return 0;
}

int connection_scan_start(void)
{
	int err;
	struct bt_scan_init_param scan_params = {
		.scan_param = NULL,
		.conn_param = &conn_param,
		.connect_if_match = 1,
	};

	err = scan_init(&scan_params);
	if (err) {
		LOG_ERR("Scan init failed (err %d)", err);
		return err;
	}

	err = bt_scan_start(BT_SCAN_TYPE_SCAN_PASSIVE);
	if (err) {
		LOG_ERR("Scanning failed to start (err %i)", err);
		return err;
	}

	return 0;
}

struct bt_conn *connection_wait_connected(void)
{
	k_sem_take(&sem_connected, K_FOREVER);
	return connection;
}

int connection_secure(struct bt_conn *conn)
{
	int err = bt_conn_set_security(conn, BT_SECURITY_L2);

	if (err) {
		LOG_ERR("Failed to encrypt connection (err %d)", err);
		return err;
	}

	k_sem_take(&sem_security, K_FOREVER);
	return 0;
}

/* ---------------------------------------------------------------------------
 * GATT: MTU exchange and Ranging Service discovery
 * ------------------------------------------------------------------------- */

static void mtu_exchange_cb(struct bt_conn *conn, uint8_t err,
			    struct bt_gatt_exchange_params *params)
{
	if (err) {
		LOG_ERR("MTU exchange failed (err %d)", err);
		return;
	}

	LOG_INF("MTU exchange success (%u)", bt_gatt_get_mtu(conn));
	k_sem_give(&sem_mtu_exchange_done);
}

void connection_exchange_mtu(struct bt_conn *conn)
{
	static struct bt_gatt_exchange_params mtu_exchange_params = {.func = mtu_exchange_cb};

	bt_gatt_exchange_mtu(conn, &mtu_exchange_params);

	k_sem_take(&sem_mtu_exchange_done, K_FOREVER);
}

static void discovery_completed_cb(struct bt_gatt_dm *dm, void *context)
{
	int err;

	LOG_INF("The discovery procedure succeeded");

	struct bt_conn *conn = bt_gatt_dm_conn_get(dm);

	bt_gatt_dm_data_print(dm);

	err = bt_ras_rreq_alloc_and_assign_handles(dm, conn);
	if (err) {
		LOG_ERR("RAS RREQ alloc init failed (err %d)", err);
	}

	err = bt_gatt_dm_data_release(dm);
	if (err) {
		LOG_ERR("Could not release the discovery data (err %d)", err);
	}

	k_sem_give(&sem_discovery_done);
}

static void discovery_service_not_found_cb(struct bt_conn *conn, void *context)
{
	LOG_INF("The service could not be found during the discovery, disconnecting");
	bt_conn_disconnect(conn, BT_HCI_ERR_REMOTE_USER_TERM_CONN);
}

static void discovery_error_found_cb(struct bt_conn *conn, int err, void *context)
{
	LOG_INF("The discovery procedure failed (err %d)", err);
	bt_conn_disconnect(conn, BT_HCI_ERR_REMOTE_USER_TERM_CONN);
}

static struct bt_gatt_dm_cb discovery_cb = {
	.completed = discovery_completed_cb,
	.service_not_found = discovery_service_not_found_cb,
	.error_found = discovery_error_found_cb,
};

int connection_discover_ras(struct bt_conn *conn)
{
	int err = bt_gatt_dm_start(conn, BT_UUID_RANGING_SERVICE, &discovery_cb, NULL);

	if (err) {
		LOG_ERR("Discovery failed (err %d)", err);
		return err;
	}

	k_sem_take(&sem_discovery_done, K_FOREVER);
	return 0;
}
```

## src/connection.h
```c
/*
 * Copyright (c) 2024 Nordic Semiconductor ASA
 *
 * SPDX-License-Identifier: LicenseRef-Nordic-5-Clause
 */

/** @file
 *  @brief Scanning, connection, security and GATT discovery of the RAS peer.
 */

#ifndef CONNECTION_H_
#define CONNECTION_H_

#include <zephyr/bluetooth/conn.h>

/** Initialize the scanner (filter on the Ranging Service UUID) and start scanning. */
int connection_scan_start(void);

/** Block until a peer is connected and return the connection. */
struct bt_conn *connection_wait_connected(void);

/** Encrypt the link (security level 2) and wait until it is done. */
int connection_secure(struct bt_conn *conn);

/** Exchange the ATT MTU and wait until it is done. */
void connection_exchange_mtu(struct bt_conn *conn);

/** Discover the peer Ranging Service, assign RAS RREQ handles and wait until done. */
int connection_discover_ras(struct bt_conn *conn);

#endif /* CONNECTION_H_ */
```

## src/cs_processing.c
```c
/*
 * Copyright (c) 2024 Nordic Semiconductor ASA
 *
 * SPDX-License-Identifier: LicenseRef-Nordic-5-Clause
 */

#include <math.h>
#include <string.h>
#include <zephyr/bluetooth/cs.h>
#include <bluetooth/services/ras.h>

#include <zephyr/logging/log.h>
LOG_MODULE_DECLARE(app_main, LOG_LEVEL_INF);

#include "cs_processing.h"

#define CS_STEP_MODE_0			(0)
#define TONE_QI_OK_TONE_COUNT_THRESHOLD (15)

static struct cs_procedure_result result;

static bool is_tone_quality_ok(const uint16_t num_iqs[CS_DE_NUM_CHANNELS],
			       const uint8_t *channel_map)
{
	uint8_t ok_tones_count = 0;

	for (uint8_t i = 0; i < CS_DE_NUM_CHANNELS; ++i) {
		if (BT_LE_CS_CHANNEL_BIT_GET(channel_map, i + CHANNEL_INDEX_OFFSET) &&
		    num_iqs[i] >= 1) {
			ok_tones_count += 1;
		}
	}
	return (ok_tones_count >= TONE_QI_OK_TONE_COUNT_THRESHOLD);
}

static void cumulate_mean(float *avg, float new_value, uint16_t *N)
{
	float a = 1.0f / (*N);
	float b = 1.0f - a;
	*avg = a * new_value + b * (*avg);
}

/* ---------------------------------------------------------------------------
 * Per-step extraction
 * ------------------------------------------------------------------------- */

static void extract_pcts(cs_de_report_t *p_report, uint8_t channel_index,
			 uint8_t antenna_permutation_index,
			 struct bt_hci_le_cs_step_data_tone_info *local_tone_info,
			 struct bt_hci_le_cs_step_data_tone_info *remote_tone_info)
{
	for (uint8_t tone_index = 0; tone_index < p_report->n_ap; tone_index++) {
		int antenna_path = bt_le_cs_get_antenna_path(p_report->n_ap,
							     antenna_permutation_index, tone_index);
		if (antenna_path < 0) {
			LOG_WRN("Invalid antenna path.");
			return;
		}

		if (local_tone_info[tone_index].quality_indicator !=
			    BT_HCI_LE_CS_TONE_QUALITY_HIGH ||
		    remote_tone_info[tone_index].quality_indicator !=
			    BT_HCI_LE_CS_TONE_QUALITY_HIGH) {
			return;
		}

		struct bt_le_cs_iq_sample local_iq =
			bt_le_cs_parse_pct(local_tone_info[tone_index].phase_correction_term);
		struct bt_le_cs_iq_sample remote_iq =
			bt_le_cs_parse_pct(remote_tone_info[tone_index].phase_correction_term);

		uint16_t *n_iqs = &result.n_iqs[antenna_path][channel_index];
		cs_de_iq_tones_t *iq_tones = &p_report->iq_tones[antenna_path];

		(*n_iqs)++;

		if (*n_iqs == 1) {
			iq_tones->i_local[channel_index] = local_iq.i;
			iq_tones->q_local[channel_index] = local_iq.q;
			iq_tones->i_remote[channel_index] = remote_iq.i;
			iq_tones->q_remote[channel_index] = remote_iq.q;
		} else {
			cumulate_mean(&iq_tones->i_local[channel_index], local_iq.i, n_iqs);
			cumulate_mean(&iq_tones->q_local[channel_index], local_iq.q, n_iqs);
			cumulate_mean(&iq_tones->i_remote[channel_index], remote_iq.i, n_iqs);
			cumulate_mean(&iq_tones->q_remote[channel_index], remote_iq.q, n_iqs);
		}
	}
}

static void extract_rtt_timings(cs_de_report_t *p_report,
				struct bt_hci_le_cs_step_data_mode_1 *local_rtt_data,
				struct bt_hci_le_cs_step_data_mode_1 *peer_rtt_data)
{
	if (local_rtt_data->packet_quality_aa_check !=
		    BT_HCI_LE_CS_PACKET_QUALITY_AA_CHECK_SUCCESSFUL ||
	    local_rtt_data->packet_rssi == BT_HCI_LE_CS_PACKET_RSSI_NOT_AVAILABLE ||
	    local_rtt_data->tod_toa_reflector == BT_HCI_LE_CS_TIME_DIFFERENCE_NOT_AVAILABLE ||
	    peer_rtt_data->packet_quality_aa_check !=
		    BT_HCI_LE_CS_PACKET_QUALITY_AA_CHECK_SUCCESSFUL ||
	    peer_rtt_data->packet_rssi == BT_HCI_LE_CS_PACKET_RSSI_NOT_AVAILABLE ||
	    peer_rtt_data->tod_toa_reflector == BT_HCI_LE_CS_TIME_DIFFERENCE_NOT_AVAILABLE) {
		return;
	}

	if (p_report->role == BT_CONN_LE_CS_ROLE_INITIATOR) {
		p_report->rtt_accumulated_half_ns +=
			local_rtt_data->toa_tod_initiator - peer_rtt_data->tod_toa_reflector;
	} else {
		p_report->rtt_accumulated_half_ns +=
			peer_rtt_data->toa_tod_initiator - local_rtt_data->tod_toa_reflector;
	}

	p_report->rtt_count++;
}

static void accumulate_rssi(uint8_t packet_quality_aa_check, uint8_t packet_rssi)
{
	if (packet_quality_aa_check != BT_HCI_LE_CS_PACKET_QUALITY_AA_CHECK_SUCCESSFUL ||
	    packet_rssi == BT_HCI_LE_CS_PACKET_RSSI_NOT_AVAILABLE) {
		return;
	}

	result.rssi_sum += (int8_t)packet_rssi;
	result.rssi_count++;
}

/* ---------------------------------------------------------------------------
 * RAS parser callbacks
 * ------------------------------------------------------------------------- */

static bool process_ranging_header(struct ras_ranging_header *ranging_header, void *user_data)
{
	cs_de_report_t *p_report = (cs_de_report_t *)user_data;

	p_report->n_ap = MAX(1, ((ranging_header->antenna_paths_mask & BIT(0)) +
				 ((ranging_header->antenna_paths_mask & BIT(1)) >> 1) +
				 ((ranging_header->antenna_paths_mask & BIT(2)) >> 2) +
				 ((ranging_header->antenna_paths_mask & BIT(3)) >> 3)));
	return true;
}

static bool process_step_data(struct bt_le_cs_subevent_step *local_step,
			      struct bt_le_cs_subevent_step *peer_step, void *user_data)
{
	cs_de_report_t *p_report = (cs_de_report_t *)user_data;

	if (local_step->mode == CS_STEP_MODE_0 &&
	    p_report->role == BT_CONN_LE_CS_ROLE_INITIATOR) {
		struct bt_hci_le_cs_step_data_mode_0_initiator *local_step_data =
			(struct bt_hci_le_cs_step_data_mode_0_initiator *)local_step->data;

		accumulate_rssi(local_step_data->packet_quality_aa_check,
				local_step_data->packet_rssi);
	} else if (local_step->mode == BT_HCI_OP_LE_CS_MAIN_MODE_2) {
		struct bt_hci_le_cs_step_data_mode_2 *local_step_data =
			(struct bt_hci_le_cs_step_data_mode_2 *)local_step->data;
		struct bt_hci_le_cs_step_data_mode_2 *peer_step_data =
			(struct bt_hci_le_cs_step_data_mode_2 *)peer_step->data;

		extract_pcts(p_report, local_step->channel - CHANNEL_INDEX_OFFSET,
			     local_step_data->antenna_permutation_index, local_step_data->tone_info,
			     peer_step_data->tone_info);
	} else if (local_step->mode == BT_HCI_OP_LE_CS_MAIN_MODE_1) {
		struct bt_hci_le_cs_step_data_mode_1 *local_step_data =
			(struct bt_hci_le_cs_step_data_mode_1 *)local_step->data;
		struct bt_hci_le_cs_step_data_mode_1 *peer_step_data =
			(struct bt_hci_le_cs_step_data_mode_1 *)peer_step->data;

		accumulate_rssi(local_step_data->packet_quality_aa_check,
				local_step_data->packet_rssi);
		extract_rtt_timings(p_report, local_step_data, peer_step_data);
	} else if (local_step->mode == BT_HCI_OP_LE_CS_MAIN_MODE_3) {
		struct bt_hci_le_cs_step_data_mode_3 *local_step_data =
			(struct bt_hci_le_cs_step_data_mode_3 *)local_step->data;
		struct bt_hci_le_cs_step_data_mode_3 *peer_step_data =
			(struct bt_hci_le_cs_step_data_mode_3 *)peer_step->data;

		extract_pcts(p_report, local_step->channel - CHANNEL_INDEX_OFFSET,
			     local_step_data->antenna_permutation_index, local_step_data->tone_info,
			     peer_step_data->tone_info);

		accumulate_rssi(local_step_data->packet_quality_aa_check,
				local_step_data->packet_rssi);
		extract_rtt_timings(p_report,
				    (struct bt_hci_le_cs_step_data_mode_1 *)local_step_data,
				    (struct bt_hci_le_cs_step_data_mode_1 *)peer_step_data);
	}

	return true;
}

/* ---------------------------------------------------------------------------
 * Public API
 * ------------------------------------------------------------------------- */

void cs_processing_extract(struct net_buf_simple *peer_steps,
			   struct net_buf_simple *local_steps,
			   const struct bt_conn_le_cs_config *config)
{
	cs_de_report_t *report = &result.report;

	memset(&result, 0, sizeof(result));
	report->role = config->role;

	bt_ras_rreq_rd_subevent_data_parse(peer_steps, local_steps, config->role,
					   process_ranging_header, NULL, process_step_data,
					   report);

	for (uint8_t ap = 0; ap < report->n_ap; ap++) {
		report->distance_estimates[ap].ifft = NAN;
		report->distance_estimates[ap].phase_slope = NAN;
		report->distance_estimates[ap].rtt = NAN;
		report->distance_estimates[ap].best = NAN;

		if (is_tone_quality_ok(result.n_iqs[ap], config->channel_map)) {
			report->tone_quality[ap] = CS_DE_TONE_QUALITY_OK;
		} else {
			report->tone_quality[ap] = CS_DE_TONE_QUALITY_BAD;
		}
	}
}

cs_de_quality_t cs_processing_estimate(void)
{
	return cs_de_calc(&result.report);
}

const struct cs_procedure_result *cs_processing_result(void)
{
	return &result;
}
```

## src/cs_processing.h
```c
/*
 * Copyright (c) 2024 Nordic Semiconductor ASA
 *
 * SPDX-License-Identifier: LicenseRef-Nordic-5-Clause
 */

/** @file
 *  @brief Extraction of tones / RTT / RSSI from CS step data and distance estimation.
 */

#ifndef CS_PROCESSING_H_
#define CS_PROCESSING_H_

#include <zephyr/net_buf.h>
#include <zephyr/bluetooth/conn.h>
#include <bluetooth/cs_de.h>

#include "app_config.h"

/** Everything computed for one CS procedure. */
struct cs_procedure_result {
	/** IQ tones, RTT accumulation, tone quality and distance estimates. */
	cs_de_report_t report;
	/** Number of high-quality tones averaged per antenna path and channel. */
	uint16_t n_iqs[MAX_AP][CS_DE_NUM_CHANNELS];
	/** RSSI accumulated over the valid local steps. */
	int32_t rssi_sum;
	uint16_t rssi_count;
};

/** Parse the local and peer step data of one procedure into the result.
 *
 *  The step buffers are no longer needed once this function returns.
 */
void cs_processing_extract(struct net_buf_simple *peer_steps,
			   struct net_buf_simple *local_steps,
			   const struct bt_conn_le_cs_config *config);

/** Run the distance estimation (cs_de) on the extracted data. */
cs_de_quality_t cs_processing_estimate(void);

/** Result of the last processed procedure. */
const struct cs_procedure_result *cs_processing_result(void);

#endif /* CS_PROCESSING_H_ */
```

## src/cs_setup.c
```c
/*
 * Copyright (c) 2024 Nordic Semiconductor ASA
 *
 * SPDX-License-Identifier: LicenseRef-Nordic-5-Clause
 */

#include <string.h>
#include <zephyr/kernel.h>
#include <zephyr/sys/byteorder.h>
#include <zephyr/bluetooth/cs.h>
#include <zephyr/bluetooth/conn.h>

#include <zephyr/logging/log.h>
LOG_MODULE_DECLARE(app_main, LOG_LEVEL_INF);

#include "app_config.h"
#include "cs_setup.h"

static K_SEM_DEFINE(sem_remote_capabilities_obtained, 0, 1);
static K_SEM_DEFINE(sem_config_created, 0, 1);
static K_SEM_DEFINE(sem_cs_security_enabled, 0, 1);

static struct bt_conn_le_cs_config cs_config;

/* ---------------------------------------------------------------------------
 * CS event callbacks
 * ------------------------------------------------------------------------- */

static void remote_capabilities_cb(struct bt_conn *conn,
				   uint8_t status,
				   struct bt_conn_le_cs_capabilities *params)
{
	ARG_UNUSED(conn);
	ARG_UNUSED(params);

	if (status == BT_HCI_ERR_SUCCESS) {
		LOG_INF("CS capability exchange completed.");
		k_sem_give(&sem_remote_capabilities_obtained);
	} else {
		LOG_WRN("CS capability exchange failed. (HCI status 0x%02x)", status);
	}
}

static void cs_config_print(const struct bt_conn_le_cs_config *config)
{
	const char *mode_str[5] = {"Unused", "1 (RTT)", "2 (PBR)", "3 (RTT + PBR)", "Invalid"};
	const char *role_str[3] = {"Initiator", "Reflector", "Invalid"};
	const char *rtt_type_str[8] = {
		"AA only",	 "32-bit sounding", "96-bit sounding", "32-bit random",
		"64-bit random", "96-bit random",   "128-bit random",  "Invalid"};
	const char *phy_str[4] = {"Invalid", "LE 1M PHY", "LE 2M PHY", "LE 2M 2BT PHY"};
	const char *chsel_type_str[3] = {"Algorithm #3b", "Algorithm #3c", "Invalid"};
	const char *ch3c_shape_str[3] = {"Hat shape", "X shape", "Invalid"};

	uint8_t mode_idx = config->mode > 0 && config->mode < 4 ? config->mode : 4;
	uint8_t role_idx = MIN(config->role, 2);
	uint8_t rtt_type_idx = MIN(config->rtt_type, 7);
	uint8_t phy_idx = config->cs_sync_phy > 0 && config->cs_sync_phy < 4
				  ? config->cs_sync_phy
				  : 0;
	uint8_t chsel_type_idx = MIN(config->channel_selection_type, 2);
	uint8_t ch3c_shape_idx = MIN(config->ch3c_shape, 2);

	LOG_INF("CS config creation complete.\n"
		" - id: %u\n"
		" - mode: %s\n"
		" - min_main_mode_steps: %u\n"
		" - max_main_mode_steps: %u\n"
		" - main_mode_repetition: %u\n"
		" - mode_0_steps: %u\n"
		" - role: %s\n"
		" - rtt_type: %s\n"
		" - cs_sync_phy: %s\n"
		" - channel_map_repetition: %u\n"
		" - channel_selection_type: %s\n"
		" - ch3c_shape: %s\n"
		" - ch3c_jump: %u\n"
		" - t_ip1_time_us: %u\n"
		" - t_ip2_time_us: %u\n"
		" - t_fcs_time_us: %u\n"
		" - t_pm_time_us: %u\n"
		" - channel_map: 0x%08X%08X%04X\n",
		config->id, mode_str[mode_idx],
		config->min_main_mode_steps, config->max_main_mode_steps,
		config->main_mode_repetition, config->mode_0_steps, role_str[role_idx],
		rtt_type_str[rtt_type_idx], phy_str[phy_idx],
		config->channel_map_repetition, chsel_type_str[chsel_type_idx],
		ch3c_shape_str[ch3c_shape_idx], config->ch3c_jump, config->t_ip1_time_us,
		config->t_ip2_time_us, config->t_fcs_time_us, config->t_pm_time_us,
		sys_get_le32(&config->channel_map[6]),
		sys_get_le32(&config->channel_map[2]),
		sys_get_le16(&config->channel_map[0]));
}

static void config_create_cb(struct bt_conn *conn, uint8_t status,
			     struct bt_conn_le_cs_config *config)
{
	ARG_UNUSED(conn);

	if (status == BT_HCI_ERR_SUCCESS) {
		cs_config = *config;
		cs_config_print(config);
		k_sem_give(&sem_config_created);
	} else {
		LOG_WRN("CS config creation failed. (HCI status 0x%02x)", status);
	}
}

static void security_enable_cb(struct bt_conn *conn, uint8_t status)
{
	ARG_UNUSED(conn);

	if (status == BT_HCI_ERR_SUCCESS) {
		LOG_INF("CS security enabled.");
		k_sem_give(&sem_cs_security_enabled);
	} else {
		LOG_WRN("CS security enable failed. (HCI status 0x%02x)", status);
	}
}

static void procedure_enable_cb(struct bt_conn *conn,
				uint8_t status,
				struct bt_conn_le_cs_procedure_enable_complete *params)
{
	ARG_UNUSED(conn);

	if (status == BT_HCI_ERR_SUCCESS) {
		if (params->state == 1) {
			LOG_INF("CS procedures enabled:\n"
				" - config ID: %u\n"
				" - antenna configuration index: %u\n"
				" - TX power: %d dbm\n"
				" - subevent length: %u us\n"
				" - subevents per event: %u\n"
				" - subevent interval: %u\n"
				" - event interval: %u\n"
				" - procedure interval: %u\n"
				" - procedure count: %u\n"
				" - maximum procedure length: %u",
				params->config_id, params->tone_antenna_config_selection,
				params->selected_tx_power, params->subevent_len,
				params->subevents_per_event, params->subevent_interval,
				params->event_interval, params->procedure_interval,
				params->procedure_count, params->max_procedure_len);
		} else {
			LOG_INF("CS procedures disabled.");
		}
	} else {
		LOG_WRN("CS procedures enable failed. (HCI status 0x%02x)", status);
	}
}

BT_CONN_CB_DEFINE(cs_setup_conn_cb) = {
	.le_cs_read_remote_capabilities_complete = remote_capabilities_cb,
	.le_cs_config_complete = config_create_cb,
	.le_cs_security_enable_complete = security_enable_cb,
	.le_cs_procedure_enable_complete = procedure_enable_cb,
};

/* ---------------------------------------------------------------------------
 * Public API
 * ------------------------------------------------------------------------- */

const struct bt_conn_le_cs_config *cs_setup_get_config(void)
{
	return &cs_config;
}

int cs_setup_default_settings(struct bt_conn *conn)
{
	const struct bt_le_cs_set_default_settings_param default_settings = {
		.enable_initiator_role = true,
		.enable_reflector_role = false,
		.cs_sync_antenna_selection = BT_LE_CS_ANTENNA_SELECTION_OPT_REPETITIVE,
		.max_tx_power = BT_HCI_OP_LE_CS_MAX_MAX_TX_POWER,
	};

	int err = bt_le_cs_set_default_settings(conn, &default_settings);

	if (err) {
		LOG_ERR("Failed to configure default CS settings (err %d)", err);
	}

	return err;
}

int cs_setup_read_remote_capabilities(struct bt_conn *conn)
{
	int err = bt_le_cs_read_remote_supported_capabilities(conn);

	if (err) {
		LOG_ERR("Failed to exchange CS capabilities (err %d)", err);
		return err;
	}

	k_sem_take(&sem_remote_capabilities_obtained, K_FOREVER);
	return 0;
}

static void cs_config_get(struct bt_le_cs_create_config_params *config_params)
{
	memset(config_params, 0, sizeof(struct bt_le_cs_create_config_params));
	config_params->id = CS_CONFIG_ID;
	config_params->mode = CS_CONFIG_MODE;
	config_params->min_main_mode_steps = 2;
	config_params->max_main_mode_steps = 5;
	config_params->main_mode_repetition = 0;
	config_params->mode_0_steps = NUM_MODE_0_STEPS;
	config_params->role = BT_CONN_LE_CS_ROLE_INITIATOR;
	config_params->rtt_type = BT_CONN_LE_CS_RTT_TYPE_AA_ONLY;
	config_params->cs_sync_phy = BT_CONN_LE_CS_SYNC_1M_PHY;
	config_params->channel_map_repetition = 1;
	config_params->channel_selection_type = BT_CONN_LE_CS_CHSEL_TYPE_3B;
	config_params->ch3c_shape = BT_CONN_LE_CS_CH3C_SHAPE_HAT;
	config_params->ch3c_jump = 2;
}

#define CS_CHMAP_MIN_CHANNELS 15

BUILD_ASSERT(CONFIG_SAMPLE_RAS_INITIATOR_CH_MIN <= CONFIG_SAMPLE_RAS_INITIATOR_CH_MAX,
	     "CH_MIN must be <= CH_MAX");

/* Restrict the spec-valid channel map to [CH_MIN, CH_MAX], one channel every CH_STEP. */
static int cs_chmap_apply_selection(uint8_t *chmap)
{
	uint8_t n_channels = 0;
	uint8_t first = 0;
	uint8_t last = 0;

	for (uint8_t ch = 0; ch < 80; ch++) {
		bool keep = BT_LE_CS_CHANNEL_BIT_GET(chmap, ch) &&
			    ch >= CONFIG_SAMPLE_RAS_INITIATOR_CH_MIN &&
			    ch <= CONFIG_SAMPLE_RAS_INITIATOR_CH_MAX &&
			    ((ch - CONFIG_SAMPLE_RAS_INITIATOR_CH_MIN) %
			     CONFIG_SAMPLE_RAS_INITIATOR_CH_STEP) == 0;

		BT_LE_CS_CHANNEL_BIT_SET_VAL(chmap, ch, keep ? 1 : 0);

		if (keep) {
			if (n_channels == 0) {
				first = ch;
			}
			last = ch;
			n_channels++;
		}
	}

	if (n_channels < CS_CHMAP_MIN_CHANNELS) {
		LOG_ERR("Channel map has %u channels, at least %u required", n_channels,
			CS_CHMAP_MIN_CHANNELS);
		return -EINVAL;
	}

	LOG_INF("Channel map: %u channels, ch %u-%u (%u-%u MHz), span %u MHz, step %u MHz",
		n_channels, first, last, 2402 + first, 2402 + last, last - first,
		CONFIG_SAMPLE_RAS_INITIATOR_CH_STEP);
	return 0;
}

int cs_setup_create_config(struct bt_conn *conn)
{
	struct bt_le_cs_create_config_params config_params;

	cs_config_get(&config_params);

	bt_le_cs_set_valid_chmap_bits(config_params.channel_map);

	int ret = cs_chmap_apply_selection(config_params.channel_map);

	if (ret) {
		return ret;
	}
	
	//
	/** 
	for(uint8_t ch = 0; ch<80; ch++){
		if (ch%2)
		{
			BT_LE_CS_CHANNEL_BIT_SET_VAL(config_params.channel_map, ch, 0);
		}
		
	}
	*/

	int err = bt_le_cs_create_config(conn, &config_params,
					 BT_LE_CS_CREATE_CONFIG_CONTEXT_LOCAL_AND_REMOTE);

	if (err) {
		LOG_ERR("Failed to create CS config (err %d)", err);
		return err;
	}

	k_sem_take(&sem_config_created, K_FOREVER);
	return 0;
}

int cs_setup_enable_security(struct bt_conn *conn)
{
	int err = bt_le_cs_security_enable(conn);

	if (err) {
		LOG_ERR("Failed to start CS Security (err %d)", err);
		return err;
	}

	k_sem_take(&sem_cs_security_enabled, K_FOREVER);
	return 0;
}

int cs_setup_start_procedures(struct bt_conn *conn, bool realtime_rd)
{
	int err;

	/* scale factor of conn_interval units to proc_interval units is 1.25/0.625 = 2 */
	const uint16_t acl_interval_in_proc_interval_units = CONN_INTERVAL * 2;
	uint16_t desired_procedure_interval = realtime_rd ? 5 : 10;
	uint16_t desired_max_procedure_length =
		acl_interval_in_proc_interval_units * (desired_procedure_interval - 1);

	const struct bt_le_cs_set_procedure_parameters_param procedure_params = {
		.config_id = CS_CONFIG_ID,
		.max_procedure_len = desired_max_procedure_length,
		.min_procedure_interval = desired_procedure_interval,
		.max_procedure_interval = desired_procedure_interval,
		.max_procedure_count = 0,
		.min_subevent_len = 16000,
		.max_subevent_len = 16000,
		.tone_antenna_config_selection = BT_LE_CS_TONE_ANTENNA_CONFIGURATION_A1_B1,
		.phy = BT_LE_CS_PROCEDURE_PHY_2M,
		.tx_power_delta = 0x80,
		.preferred_peer_antenna = BT_LE_CS_PROCEDURE_PREFERRED_PEER_ANTENNA_1,
		.snr_control_initiator = BT_LE_CS_SNR_CONTROL_NOT_USED,
		.snr_control_reflector = BT_LE_CS_SNR_CONTROL_NOT_USED,
	};

	err = bt_le_cs_set_procedure_parameters(conn, &procedure_params);
	if (err) {
		LOG_ERR("Failed to set procedure parameters (err %d)", err);
		return err;
	}

	struct bt_le_cs_procedure_enable_param params = {
		.config_id = CS_CONFIG_ID,
		.enable = 1,
	};

	err = bt_le_cs_procedure_enable(conn, &params);
	if (err) {
		LOG_ERR("Failed to enable CS procedures (err %d)", err);
		return err;
	}

	return 0;
}
```

## src/cs_setup.h
```c
/*
 * Copyright (c) 2024 Nordic Semiconductor ASA
 *
 * SPDX-License-Identifier: LicenseRef-Nordic-5-Clause
 */

/** @file
 *  @brief Channel Sounding configuration and procedure control (initiator side).
 *
 *  Every function blocks until the corresponding HCI event has been received.
 */

#ifndef CS_SETUP_H_
#define CS_SETUP_H_

#include <stdbool.h>
#include <zephyr/bluetooth/conn.h>

/** Enable the initiator role in the local controller. */
int cs_setup_default_settings(struct bt_conn *conn);

/** Read the CS capabilities of the peer. */
int cs_setup_read_remote_capabilities(struct bt_conn *conn);

/** Create the CS configuration on both sides. */
int cs_setup_create_config(struct bt_conn *conn);

/** Start the CS security procedure. */
int cs_setup_enable_security(struct bt_conn *conn);

/** Set the procedure parameters and enable CS procedures.
 *
 *  @param realtime_rd true if the peer sends ranging data in real time
 *                     (allows a shorter procedure interval).
 */
int cs_setup_start_procedures(struct bt_conn *conn, bool realtime_rd);

/** CS configuration negotiated with the peer (valid after cs_setup_create_config()). */
const struct bt_conn_le_cs_config *cs_setup_get_config(void);

#endif /* CS_SETUP_H_ */
```

## src/csv_export.c
```c
/*
 * Copyright (c) 2024 Nordic Semiconductor ASA
 *
 * SPDX-License-Identifier: LicenseRef-Nordic-5-Clause
 */

#include <math.h>
#include <string.h>
#include <zephyr/kernel.h>
#include <zephyr/sys/atomic.h>
#include <zephyr/sys/printk.h>

#include "app_config.h"
#include "csv_export.h"

#define CSV_HEADER                                                                                 \
	"timestamp_ms,ranging_counter,ap,channel,freq_mhz,h_re,h_im,amplitude,phase_deg,n_iqs"

#define CSV_PROC_HEADER                                                                            \
	"timestamp_ms,ranging_counter,ap,tone_quality,rtt_count,rtt_mean_ns,tof_ns,rssi_dbm,"     \
	"dist_ifft_m,dist_phase_slope_m,dist_rtt_m"

#define CSV_THREAD_STACK_SIZE 2048
#define CSV_THREAD_PRIORITY   K_LOWEST_APPLICATION_THREAD_PRIO

struct csv_snapshot {
	int64_t timestamp_ms;
	uint16_t ranging_counter;
	uint8_t n_ap;
	cs_de_iq_tones_t iq_tones[MAX_AP];
	uint16_t n_iqs[MAX_AP][CS_DE_NUM_CHANNELS];
	cs_de_tone_quality_t tone_quality[MAX_AP];
	cs_de_dist_estimates_t distance_estimates[MAX_AP];
	int32_t rtt_accumulated_half_ns;
	uint8_t rtt_count;
	float rssi_dbm;
};

static struct csv_snapshot csv_snapshot;
static atomic_t csv_snapshot_busy;
static K_SEM_DEFINE(sem_csv_ready, 0, 1);
static uint32_t csv_skipped_procedures;

void csv_export_submit(uint16_t ranging_counter, const struct cs_procedure_result *res)
{
	const cs_de_report_t *report = &res->report;

	if (!atomic_cas(&csv_snapshot_busy, 0, 1)) {
		/* Previous procedure still being printed: skip this one. */
		csv_skipped_procedures++;
		return;
	}

	csv_snapshot.timestamp_ms = k_uptime_get();
	csv_snapshot.ranging_counter = ranging_counter;
	csv_snapshot.n_ap = MIN(report->n_ap, MAX_AP);
	memcpy(csv_snapshot.iq_tones, report->iq_tones, sizeof(csv_snapshot.iq_tones));
	memcpy(csv_snapshot.n_iqs, res->n_iqs, sizeof(csv_snapshot.n_iqs));
	memcpy(csv_snapshot.tone_quality, report->tone_quality,
	       sizeof(csv_snapshot.tone_quality));
	memcpy(csv_snapshot.distance_estimates, report->distance_estimates,
	       sizeof(csv_snapshot.distance_estimates));
	csv_snapshot.rtt_accumulated_half_ns = report->rtt_accumulated_half_ns;
	csv_snapshot.rtt_count = report->rtt_count;
	csv_snapshot.rssi_dbm = res->rssi_count ? (float)res->rssi_sum / res->rssi_count : NAN;

	k_sem_give(&sem_csv_ready);
}

static void csv_snapshot_print(const struct csv_snapshot *snap)
{
	/* RTT (and therefore ToF / RTT distance) is computed once per procedure. */
	float rtt_mean_ns = NAN;
	float tof_ns = NAN;

	if (snap->rtt_count > 0) {
		rtt_mean_ns = (snap->rtt_accumulated_half_ns * 0.5f) / snap->rtt_count;
		tof_ns = rtt_mean_ns / 2.0f;
	}

	float dist_rtt_m = snap->distance_estimates[0].rtt;

	for (uint8_t ap = 0; ap < snap->n_ap; ap++) {
		const cs_de_iq_tones_t *iq = &snap->iq_tones[ap];
		const cs_de_dist_estimates_t *de = &snap->distance_estimates[ap];
		const char *tq = snap->tone_quality[ap] == CS_DE_TONE_QUALITY_OK ? "OK" : "BAD";

		printk("CSVP,%lld,%u,%u,%s,%u,%.2f,%.2f,%.1f,%.3f,%.3f,%.3f\n", snap->timestamp_ms,
		       snap->ranging_counter, ap, tq, snap->rtt_count, (double)rtt_mean_ns,
		       (double)tof_ns, (double)snap->rssi_dbm, (double)de->ifft,
		       (double)de->phase_slope, (double)dist_rtt_m);

		for (uint8_t i = 0; i < CS_DE_NUM_CHANNELS; i++) {
			if (snap->n_iqs[ap][i] == 0) {
				continue;
			}

			/* Two-way channel response H = local * remote (same as cs_de). */
			float h_re = iq->i_local[i] * iq->i_remote[i] -
				     iq->q_local[i] * iq->q_remote[i];
			float h_im = iq->i_local[i] * iq->q_remote[i] +
				     iq->i_remote[i] * iq->q_local[i];
			float amplitude = sqrtf(h_re * h_re + h_im * h_im);
			float phase_deg = atan2f(h_im, h_re) * (180.0f / 3.14159265f);
			uint8_t channel = i + CHANNEL_INDEX_OFFSET;

			printk("CSV,%lld,%u,%u,%u,%u,%.4f,%.4f,%.4f,%.2f,%u\n", snap->timestamp_ms,
			       snap->ranging_counter, ap, channel, 2402 + channel, (double)h_re,
			       (double)h_im, (double)amplitude, (double)phase_deg,
			       snap->n_iqs[ap][i]);
		}
	}
}

static void csv_thread(void *p1, void *p2, void *p3)
{
	ARG_UNUSED(p1);
	ARG_UNUSED(p2);
	ARG_UNUSED(p3);

	printk("CSVH," CSV_HEADER "\n");
	printk("CSVPH," CSV_PROC_HEADER "\n");

	while (true) {
		k_sem_take(&sem_csv_ready, K_FOREVER);
		csv_snapshot_print(&csv_snapshot);
		atomic_set(&csv_snapshot_busy, 0);
	}
}

K_THREAD_DEFINE(csv_thread_id, CSV_THREAD_STACK_SIZE, csv_thread, NULL, NULL, NULL,
		CSV_THREAD_PRIORITY, 0, 0);
```

## src/csv_export.h
```c
/*
 * Copyright (c) 2024 Nordic Semiconductor ASA
 *
 * SPDX-License-Identifier: LicenseRef-Nordic-5-Clause
 */

/** @file
 *  @brief CSV export of per-procedure CS data over the console.
 *
 *  Two record types, so that per-procedure values are not repeated on every
 *  channel row:
 *   - tones:      one row per (procedure, antenna path, channel with at least
 *                 one valid tone), prefixed with "CSV," (header "CSVH,").
 *   - procedures: one row per (procedure, antenna path), prefixed with "CSVP,"
 *                 (header "CSVPH,"). Holds everything computed once per
 *                 procedure: tone quality, RTT, ToF, RSSI, distance estimates.
 *  Join the two on (ranging_counter, ap).
 *  Must match TONE_HEADER / PROC_HEADER in scripts/cs_csv_logger.py.
 *
 *  Printing is done by a low-priority thread so that the Bluetooth thread is
 *  never blocked by the console.
 */

#ifndef CSV_EXPORT_H_
#define CSV_EXPORT_H_

#include <stdint.h>

#include "cs_processing.h"

/** Copy the procedure result so it can be printed by the CSV thread.
 *
 *  If the previous procedure is still being printed, this one is skipped.
 */
void csv_export_submit(uint16_t ranging_counter, const struct cs_procedure_result *res);

#endif /* CSV_EXPORT_H_ */
```

## src/distance_estimate.c
```c
/*
 * Copyright (c) 2024 Nordic Semiconductor ASA
 *
 * SPDX-License-Identifier: LicenseRef-Nordic-5-Clause
 */

#include <math.h>
#include <stdlib.h>
#include <string.h>
#include <zephyr/kernel.h>

#include <zephyr/logging/log.h>
LOG_MODULE_DECLARE(app_main, LOG_LEVEL_INF);

#include "app_config.h"
#include "distance_estimate.h"

#define DE_SLIDING_WINDOW_SIZE (9)

struct distance_estimate_buffer {
	cs_de_dist_estimates_t estimates[DE_SLIDING_WINDOW_SIZE];
	uint8_t num_valid;
	uint8_t index;
};

static struct distance_estimate_buffer distance_estimate_buffers[MAX_AP];

static K_MUTEX_DEFINE(distance_estimate_buffer_mutex);
static K_SEM_DEFINE(sem_distance_estimate_updated, 0, 1);

static void store_distance_estimates_in_buffer(const cs_de_dist_estimates_t *p_estimates,
					       struct distance_estimate_buffer *buffer)
{
	int lock_state = k_mutex_lock(&distance_estimate_buffer_mutex, K_FOREVER);

	__ASSERT_NO_MSG(lock_state == 0);

	memcpy(&buffer->estimates[buffer->index], p_estimates, sizeof(cs_de_dist_estimates_t));

	buffer->index = (buffer->index + 1) % DE_SLIDING_WINDOW_SIZE;

	if (buffer->num_valid < DE_SLIDING_WINDOW_SIZE) {
		buffer->num_valid++;
	}

	k_mutex_unlock(&distance_estimate_buffer_mutex);
}

static int float_cmp(const void *a, const void *b)
{
	float fa = *(const float *)a;
	float fb = *(const float *)b;

	return (fa > fb) - (fa < fb);
}

static float median_inplace(int count, float *values)
{
	if (count == 0) {
		return NAN;
	}

	qsort(values, count, sizeof(float), float_cmp);

	if (count % 2 == 0) {
		return (values[count/2] + values[count/2 - 1]) / 2;
	} else {
		return values[count/2];
	}
}

static cs_de_dist_estimates_t get_distance(uint8_t ap)
{
	cs_de_dist_estimates_t averaged_result = {};
	uint8_t num_ifft = 0;
	uint8_t num_phase_slope = 0;
	uint8_t num_rtt = 0;

	static float temp_ifft[DE_SLIDING_WINDOW_SIZE];
	static float temp_phase_slope[DE_SLIDING_WINDOW_SIZE];
	static float temp_rtt[DE_SLIDING_WINDOW_SIZE];

	struct distance_estimate_buffer *buffer = &distance_estimate_buffers[ap];

	int lock_state = k_mutex_lock(&distance_estimate_buffer_mutex, K_FOREVER);

	__ASSERT_NO_MSG(lock_state == 0);

	for (uint8_t i = 0; i < buffer->num_valid; i++) {
		if (isfinite(buffer->estimates[i].ifft)) {
			temp_ifft[num_ifft] = buffer->estimates[i].ifft;
			num_ifft++;
		}
		if (isfinite(buffer->estimates[i].phase_slope)) {
			temp_phase_slope[num_phase_slope] = buffer->estimates[i].phase_slope;
			num_phase_slope++;
		}
		if (isfinite(buffer->estimates[i].rtt)) {
			temp_rtt[num_rtt] = buffer->estimates[i].rtt;
			num_rtt++;
		}
	}

	k_mutex_unlock(&distance_estimate_buffer_mutex);

	averaged_result.ifft = median_inplace(num_ifft, temp_ifft);
	averaged_result.phase_slope = median_inplace(num_phase_slope, temp_phase_slope);
	averaged_result.rtt = median_inplace(num_rtt, temp_rtt);

	return averaged_result;
}

void distance_estimate_update(const cs_de_report_t *report)
{
	for (uint8_t ap = 0; ap < report->n_ap; ap++) {
		if (report->tone_quality[ap] == CS_DE_TONE_QUALITY_OK ||
		    isfinite(report->distance_estimates[ap].rtt)) {
			store_distance_estimates_in_buffer(&report->distance_estimates[ap],
							   &distance_estimate_buffers[ap]);
		}
	}
	k_sem_give(&sem_distance_estimate_updated);
}

void distance_estimate_wait(void)
{
	k_sem_take(&sem_distance_estimate_updated, K_FOREVER);
}

bool distance_estimate_available(uint8_t ap)
{
	return distance_estimate_buffers[ap].num_valid != 0;
}

void distance_estimate_print(uint8_t ap)
{
	cs_de_dist_estimates_t distance_on_ap = get_distance(ap);
#if defined(CONFIG_SAMPLE_RAS_INITIATOR_STEP_MODE_1)
	LOG_INF("Latest distance estimate rtt: %.2f meters", (double)distance_on_ap.rtt);
#elif defined(CONFIG_SAMPLE_RAS_INITIATOR_STEP_MODE_2)
	LOG_INF("Latest distance estimates on antenna path %u: ifft: %.2f, phase_slope: %.2f "
		"meters",
		ap, (double)distance_on_ap.ifft, (double)distance_on_ap.phase_slope);
#elif defined(CONFIG_SAMPLE_RAS_INITIATOR_STEP_MODE_2_SUB_MODE_1) || \
	defined(CONFIG_SAMPLE_RAS_INITIATOR_STEP_MODE_3)
	LOG_INF("Latest distance estimates on antenna path %u: ifft: %.2f, phase_slope: %.2f, rtt: "
		"%.2f meters",
		ap, (double)distance_on_ap.ifft, (double)distance_on_ap.phase_slope,
		(double)distance_on_ap.rtt);
#else
	BUILD_ASSERT(false, "Invalid ranging mode");
#endif
}
```

## src/distance_estimate.h
```c
/*
 * Copyright (c) 2024 Nordic Semiconductor ASA
 *
 * SPDX-License-Identifier: LicenseRef-Nordic-5-Clause
 */

/** @file
 *  @brief Sliding-window median filtering of the distance estimates.
 */

#ifndef DISTANCE_ESTIMATE_H_
#define DISTANCE_ESTIMATE_H_

#include <stdbool.h>
#include <stdint.h>
#include <bluetooth/cs_de.h>

/** Store the estimates of every usable antenna path of a report and wake up the reader. */
void distance_estimate_update(const cs_de_report_t *report);

/** Block until new estimates have been stored. */
void distance_estimate_wait(void);

/** True if at least one estimate has been stored for the antenna path. */
bool distance_estimate_available(uint8_t ap);

/** Log the median of the sliding window for the antenna path. */
void distance_estimate_print(uint8_t ap);

#endif /* DISTANCE_ESTIMATE_H_ */
```
